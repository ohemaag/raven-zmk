## zmk-config-raven/config/boards/shields/ortho/Kconfig.defconfig
```kconfig
if SHIELD_ORTHOLEFT

    config ZMK_KEYBOARD_NAME
        default "orthoL"

    config ZMK_SPLIT_BLE_ROLE_CENTRAL
        default y

endif

if SHIELD_ORTHORIGHT

    config ZMK_KEYBOARD_NAME
        default "orthoR"

endif

if SHIELD_ORTHOLEFT || SHIELD_ORTHORIGHT

    config ZMK_SPLIT
        default y

endif
```

## zmk-config-raven/config/boards/shields/ortho/Kconfig.shield
```kconfig
config SHIELD_ORTHOLEFT
    def_bool $(shields_list_contains,ortholeft)

config SHIELD_ORTHORIGHT
    def_bool $(shields_list_contains,orthoright)
```
